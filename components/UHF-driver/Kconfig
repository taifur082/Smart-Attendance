## components/UHF-driver/Kconfig
```kconfig
# UHF RFID reader driver (J4210U / 910 / 903) configuration

config UHF_UART_TXD_PIN
    int "UART TX GPIO pin (connected to reader RX)"
    default 17
    help
        GPIO number for UART TX. Connect this to the UHF reader's RX pin.

config UHF_UART_RXD_PIN
    int "UART RX GPIO pin (connected to reader TX)"
    default 16
    help
        GPIO number for UART RX. Connect this to the UHF reader's TX pin.
```

## main/Kconfig.projbuild
```kconfig
# menu "Display Configuration"
#     menu "SPI Pins"
#     config SPI_CLOCK
#         int "SPI Clock Pin"
#         default 14
#         help
#             Pin number for SPI Clock
    
#     config SPI_MOSI
#         int "SPI MOSI Pin"
#         default 13
#         help
#             Pin number for SPI MOSI
    
#     config SPI_MISO
#         int "SPI MISO Pin"
#         default 12
#         help
#             Pin number for SPI MISO
    
#     config TFT_CS_PIN
#         int "TFT Chip Select Pin"
#         default 15
#         help
#             Pin number for TFT Chip Select
    
#     config TFT_DC_PIN
#         int "TFT Data/Command Pin"
#         default 2
#         help
#             Pin number for TFT Data/Command
#     endmenu

#     menu "Other Pins"
#     config TFT_BACKLIGHT_PIN
#         int "TFT Backlight Pin"
#         default -1
#         help
#             Pin number for TFT Backlight
    
#     config TFT_RESET_PIN
#         int "TFT Reset Pin"
#         default -1
#         help
#             Pin number for TFT Reset
#     endmenu

# choice DISPLAY_COLOR_MODE
#     bool "Color Mode"
#     default DISPLAY_COLOR_MODE_BGR
#     config DISPLAY_COLOR_MODE_BGR
#         bool "Blue,Green,Red"
#     config DISPLAY_COLOR_MODE_RGB
#         bool "Red,Green,Blue"
# endchoice

# config CONFIG_USE_IO_FOR_BACKLIGHT
#     bool "Use IO for Backlight"
#     default 0 if TFT_BACKLIGHT_PIN = -1
#     default 1 if TFT_BACKLIGHT_PIN != -1
#     help
#         Set to 0 if backlight pin is not used, 1 otherwise

# config DISPLAY_COLOR_MODE
#     int
#     default 1 if DISPLAY_COLOR_MODE_BGR
#     default 0 if DISPLAY_COLOR_MODE_RGB
# endmenu


menu "OTA Configuration"

    config FIRMWARE_UPGRADE_URL
        string "firmware upgrade url endpoint"
        default NULL
        help
            URL of server which hosts the firmware
            image.

    config EXAMPLE_FIRMWARE_UPGRADE_URL_FROM_STDIN
        bool
        default y if EXAMPLE_FIRMWARE_UPGRADE_URL = "FROM_STDIN"

    config EXAMPLE_SKIP_COMMON_NAME_CHECK
        bool "Skip server certificate CN fieldcheck"
        default n
        help
            This allows you to skip the validation of OTA server certificate CN field.

    config EXAMPLE_FIRMWARE_UPGRADE_BIND_IF
        bool "Support firmware upgrade bind specified interface"
        default n
        help
            This allows you to bind specified interface in OTA example.

    choice EXAMPLE_FIRMWARE_UPGRADE_BIND_IF_TYPE
        prompt "Choose OTA data bind interface"
        default EXAMPLE_FIRMWARE_UPGRADE_BIND_IF_STA
        depends on EXAMPLE_FIRMWARE_UPGRADE_BIND_IF
        help
            Select which interface type of OTA data go through.

        config EXAMPLE_FIRMWARE_UPGRADE_BIND_IF_STA
            bool "Bind wifi station interface"
            depends on EXAMPLE_CONNECT_WIFI
            help
                Select wifi station interface to pass the OTA data.

        config EXAMPLE_FIRMWARE_UPGRADE_BIND_IF_ETH
            bool "Bind ethernet interface"
            depends on EXAMPLE_CONNECT_ETHERNET
            help
                Select ethernet interface to pass the OTA data.
    endchoice
endmenu
```

## rc522-attendance/components/rc522-driver/Kconfig
```kconfig
# RC522 RFID reader driver configuration

config RC522_SPI_MOSI_PIN
    int "SPI MOSI GPIO pin"
    default 5
    help
        GPIO connected to RC522 MOSI.

config RC522_SPI_MISO_PIN
    int "SPI MISO GPIO pin"
    default 4
    help
        GPIO connected to RC522 MISO.

config RC522_SPI_SCK_PIN
    int "SPI SCK GPIO pin"
    default 6
    help
        GPIO connected to RC522 SCK.

config RC522_SPI_CS_PIN
    int "SPI CS (SDA) GPIO pin"
    default 7
    help
        GPIO connected to RC522 SDA (chip select).

config RC522_RST_PIN
    int "RST GPIO pin"
    default 2
    help
        GPIO connected to RC522 RST (any free GPIO; do NOT use the board's EN/RST pin).

config RC522_SPI_CLOCK_HZ
    int "SPI clock speed (Hz)"
    default 5000000
    help
        SPI clock in Hz. 5 MHz is safe for most RC522 breakout boards.
```
